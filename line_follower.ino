
/* define the value of PID constant that can be generated by experimenting*/
#define Kp 60
#define Kd 150
#define Ki 0.00001 


// defining max speed and base speed of the motor

#define rightMaxSpeed 120
#define leftMaxSpeed 120
#define rightBaseSpeed 115 
#define leftBaseSpeed 115

/* Motors name and the input and output port of the arduino associated with it*/
#define INTENSITY 200     //intensity may vary as per situation
#define RM1 9 
#define RM2 10
#define RMP 11
#define LM1 8 
#define LM2 7 
#define LMP 6


/* IR sensors name and the input and output port of the arduino associated with it*/
#define IR1 A7
#define IR2 A6
#define IR3 A5
#define IR4 A4
#define IR5 A3
#define IR6 A2

#define timelapse 100

int irarr[6];
int error=0;
int lasterror=0;
int ck_arr=0;
int integral_error=0;



int sense(int IR)
{
    int x=analogRead(IR);
    if(x > INTENSITY)
        return 1;  
    else
        return 0;
}

void irscan(int * irarr)
{
    irarr[0]=sense(IR1);
    irarr[1]=sense(IR2);
    irarr[2]=sense(IR3);
    irarr[3]=sense(IR4);
    irarr[4]=sense(IR5);
    irarr[5]=sense(IR6);   
}

int calc_error(int * irarr)
{
  int sum=0,i;
  for(i=0;i<6;i++)
  {
    if(irarr[i]==1)
    sum=sum+1;
  }
    return sum-3; 
}

void stop_bot()
{
  analogWrite(RMP, 0);
  analogWrite(LMP, 0);
}

void forward()
{
  
  digitalWrite(RM1, HIGH);
  digitalWrite(RM2, LOW);
  analogWrite(RMP, 120);
  digitalWrite(LM1, HIGH);
  digitalWrite(LM2, LOW);
  analogWrite(LMP,120);
  delay(300);
}

void setup() {
  Serial.begin(9600);
  
  pinMode(IR1,INPUT);
  pinMode(IR2,INPUT);
  pinMode(IR3,INPUT);
  pinMode(IR4,INPUT);
  pinMode(IR5,INPUT);
  pinMode(IR6,INPUT);
  pinMode(3,OUTPUT);
  pinMode(4,OUTPUT);
  pinMode(RM1,OUTPUT);
  pinMode(RM2,OUTPUT);
  pinMode(RMP,OUTPUT);
  pinMode(LM1,OUTPUT);
  pinMode(LM2,OUTPUT);
  pinMode(LMP,OUTPUT);
  
 /* digitalWrite(RM1, HIGH);
  digitalWrite(RM2, LOW);
  digitalWrite(LM1, HIGH);
  digitalWrite(LM2, LOW);

  delay(1000);*/
  forward();
}

void loop() {
  // put your main code here, to run repeatedly:
  irscan(irarr);

  /*
    To print the value of IR sensors data int the serial monitor
  Serial.print(irarr[0]);
  Serial.print("\t");
  Serial.print(irarr[1]);
  Serial.print("\t");
  Serial.print(irarr[2]);
  Serial.print("\t");
  Serial.print(irarr[3]);
  Serial.print("\t");
  Serial.print(irarr[4]);
  Serial.print("\t");
  Serial.print(irarr[5]);
  Serial.print("\t");
  */

  // Implementation of PID //
  
  int error=calc_error(irarr);
  integral_error=integral_error + error;
  float motorSpeed = Kp * error + Ki * integral_error+ Kd * (error - lasterror);
   lasterror = error;
   
   // Serial.print(error);
   // Serial.print("\t");
  
  // modificaton of motor speed after calculation new motor speed using PID
 
  int RMS = rightBaseSpeed + motorSpeed;
  int LMS = leftBaseSpeed - motorSpeed;
  
  if (RMS > rightMaxSpeed ) RMS = rightMaxSpeed; 
  if (LMS > leftMaxSpeed ) LMS = leftMaxSpeed; 
  if (RMS < 0) RMS = 0; 
  if (LMS < 0) LMS = 0; 


  // sending the output to the motors
  digitalWrite(RM1, HIGH);
  digitalWrite(RM2, LOW);
  analogWrite(RMP, RMS);
  digitalWrite(LM1, HIGH);
  digitalWrite(LM2, LOW);
  analogWrite(LMP,LMS);
  /*
   Serial.print(LMS);
   Serial.print("\t");
   Serial.print(RMS);
   Serial.print("\t");
 */


}
